## boards/eyelashperipherals/eyelash_corne/board.yml
```yaml
boards:
  - name: eyelash_corne_left
    vendor: eyelashperipherals
    socs:
      - name: nrf52840
        variants:
          - name: zmk
  - name: eyelash_corne_right
    vendor: eyelashperipherals
    socs:
      - name: nrf52840
        variants:
          - name: zmk
```
